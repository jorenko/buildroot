## package/python-jaraco-context/Config.in
```kconfig
config BR2_PACKAGE_PYTHON_JARACO_CONTEXT
	bool "python-jaraco-context"
	help
	  Useful context manager utilities.

	  https://github.com/jaraco/jaraco.context
```

## package/python-jaraco-text/Config.in
```kconfig
config BR2_PACKAGE_PYTHON_JARACO_TEXT
	bool "python-jaraco-text"
	select BR2_PACKAGE_PYTHON_FUNCTOOLS # runtime
	select BR2_PACKAGE_PYTHON_JARACO_CONTEXT # runtime
	select BR2_PACKAGE_PYTHON_AUTOCOMMAND # runtime
	select BR2_PACKAGE_PYTHON_INFLECT # runtime
	select BR2_PACKAGE_PYTHON_MORE_ITERTOOLS # runtime
	help
	  This package provides handy routines for dealing with text, such as wrapping, substitution, trimming, stripping, prefix and suffix removal, line continuation, indentation, comment processing, identifier processing, values parsing, case insensitive

	  https://github.com/jaraco/jaraco.text
```
